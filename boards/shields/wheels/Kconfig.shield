## boards/shields/wheels/Kconfig.shield
```kconfig
# Copyright (c) 2020 Pete Johanson
# SPDX-License-Identifier: MIT

config SHIELD_WHEELS_LEFT
    def_bool $(shields_list_contains,wheels_left)

config SHIELD_WHEELS_RIGHT
    def_bool $(shields_list_contains,wheels_right)
```
